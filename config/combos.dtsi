#include "keycodes.h"

compatible = "zmk,combos";

#define COMBO(NAME, BINDINGS, KEYPOS, LAYERS) \
  combo_##NAME { \
    bindings = <BINDINGS>; \
    key-positions = <KEYPOS>; \
    layers = <LAYERS>; \
  };

/*                KEY POSITIONS

  ╭────────────────────────╮ ╭────────────────────────╮
  │  0   1   2   3   4   5 │ │  6   7   8   9  10  11 │
  │ 12  13  14  15  16  17 │ │ 18  19  20  21  22  23 │
  │ 24  25  26  27  28  29 │ │ 30  31  32  33  34  35 │
  ╰───────────╮ 36  37  38 │ │ 39  40  41 ╭───────────╯
              ╰────────────╯ ╰────────────╯
*/

COMBO(backspace, &kp BACKSPACE, 7 8, DEF NAV NUM)
COMBO(delete, &kp DELETE, 6 7, DEF NAV NUM)
COMBO(escape, &kp ESCAPE, 13 14, DEF NAV NUM)
COMBO(enter, &kp ENTER, 19 20, DEF NAV NUM)
COMBO(tab, &kp TAB, 31 32, DEF NAV NUM)

COMBO(left_parenthesis, &kp LEFT_PARENTHESIS, 16 19, DEF)
COMBO(left_brace, &kp LEFT_BRACE, 16 20, DEF)
COMBO(left_bracket, &kp LEFT_BRACKET, 16 21, DEF)
COMBO(less_than, &kp LESS_THAN, 16 22, DEF)
COMBO(right_parenthesis, &kp RIGHT_PARENTHESIS, 16 7, DEF)
COMBO(right_brace, &kp RIGHT_BRACE, 16 8, DEF)
COMBO(right_bracket, &kp RIGHT_BRACKET, 16 9, DEF)
COMBO(more_than, &kp GREATER_THAN, 16 10, DEF)

COMBO(CARET, &kp CARET, 15 6, DEF)
COMBO(PIPE, &kp PIPE, 15 7, DEF)
COMBO(BACKSLASH, &kp BACKSLASH, 15 8, DEF)
COMBO(AT, &kp AT, 15 9, DEF)
COMBO(DOLLAR, &kp DOLLAR, 15 10, DEF)
COMBO(TILDE, &kp TILDE, 15 18, DEF)
COMBO(COLON, &kp COLON, 15 19, DEF)
COMBO(SEMICOLON, &kp SEMICOLON, 15 20, DEF)
COMBO(HASH, &kp HASH, 15 21, DEF)
COMBO(PERCENT, &kp PERCENT, 15 22, DEF)

COMBO(undo, MAC_UNDO, 25 26, DEF)
COMBO(redo, MAC_REDO, 25 13, DEF)
COMBO(copy, MAC_COPY, 26 27, DEF)
COMBO(cut, MAC_CUT, 26 28, DEF)
COMBO(paste, MAC_PASTE, 27 28, DEF)
COMBO(select_all, MAC_SELECT_ALL, 25 28, DEF)

// COMBO(tab_left, o_TABL_, 28 29, DEF)
// COMBO(tab_right, o_TABR_, 29 30, DEF)

COMBO(aelig, _AELIG_, 8 9, DEF)
COMBO(oslsh, _OSLSH_, 20 21, DEF)
COMBO(aring, _ARING_, 32 33, DEF)

COMBO(num_1, &kp N1, 14 31, DEF)
COMBO(num_2, &kp N2, 14 32, DEF)
COMBO(num_3, &kp N3, 14 33, DEF)
COMBO(num_4, &kp N4, 14 19, DEF)
COMBO(num_5, &kp N5, 14 20, DEF)
COMBO(num_6, &kp N6, 14 21, DEF)
COMBO(num_7, &kp N7, 14 7, DEF)
COMBO(num_8, &kp N8, 14 8, DEF)
COMBO(num_9, &kp N9, 14 9, DEF)
COMBO(num_0, &kp N0, 14 18, DEF)

COMBO(combo_z, &kp Z, 3 4, DEF)
COMBO(combo_q, &kp Q, 2 3, DEF)

//combo_lf {
//  bindings = <&macro_lf>;
//  key-positions = <1 2>;
//  layers = <DEF>;
//};
//combo_lp {
//  bindings = <&macro_lp>;
//  key-positions = <2 3>;
//  layers = <DEF>;
//};
//combo_qu {
//  bindings = <&macro_qu>;
//  key-positions = <26 28>;
//  layers = <DEF>;
//};
